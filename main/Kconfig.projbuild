## main/Kconfig.projbuild
```kconfig
menu "Over The Air Updates configuration"
  menu "Wifi configuration"
      config ESP_WIFI_SSID
          string "WiFi SSID"
          default "myssid"
          help
              SSID (network name) for the station to connect to.

      config ESP_WIFI_PASSWORD
          string "WiFi Password"
          default "mypassword"
          help
              WiFi password (WPA or WPA2) for the station to use.

      choice ESP_WIFI_SAE_MODE
          prompt "WPA3 SAE mode selection"
          default ESP_WPA3_SAE_PWE_BOTH
          help
              Select mode for SAE as Hunt and Peck, H2E or both.
          config ESP_WPA3_SAE_PWE_HUNT_AND_PECK
              bool "HUNT AND PECK"
          config ESP_WPA3_SAE_PWE_HASH_TO_ELEMENT
              bool "H2E"
          config ESP_WPA3_SAE_PWE_BOTH
              bool "BOTH"
      endchoice

      config ESP_WIFI_PW_ID
          string "PASSWORD IDENTIFIER"
          depends on  ESP_WPA3_SAE_PWE_HASH_TO_ELEMENT|| ESP_WPA3_SAE_PWE_BOTH
          default ""
          help
              password identifier for SAE H2E

      config ESP_MAX_RETRY
          int "Maximum retry"
          default 5
          help
              Set the Maximum retry to avoid station reconnecting to the AP unlimited when the AP is really inexistent.

      choice ESP_WIFI_SCAN_AUTH_MODE_THRESHOLD
          prompt "WiFi Scan auth mode threshold"
          default ESP_WIFI_AUTH_WPA2_PSK
          help
              The weakest authmode to accept in the scan mode.
              This value defaults to ESP_WIFI_AUTH_WPA2_PSK incase password is present and ESP_WIFI_AUTH_OPEN is used.
              Please select ESP_WIFI_AUTH_WEP/ESP_WIFI_AUTH_WPA_PSK incase AP is operating in WEP/WPA mode.

          config ESP_WIFI_AUTH_OPEN
              bool "OPEN"
          config ESP_WIFI_AUTH_WEP
              bool "WEP"
          config ESP_WIFI_AUTH_WPA_PSK
              bool "WPA PSK"
          config ESP_WIFI_AUTH_WPA2_PSK
              bool "WPA2 PSK"
          config ESP_WIFI_AUTH_WPA_WPA2_PSK
              bool "WPA/WPA2 PSK"
          config ESP_WIFI_AUTH_WPA3_PSK
              bool "WPA3 PSK"
          config ESP_WIFI_AUTH_WPA2_WPA3_PSK
              bool "WPA2/WPA3 PSK"
          config ESP_WIFI_AUTH_WAPI_PSK
              bool "WAPI PSK"
      endchoice

  endmenu

  menu "Upgrade server"
      config FIRMWARE_UPG_URL
          string "Firmware Upgrade URL"
          default "https://192.168.2.106:8070/esp32_secure_ota.bin"
          help
              URL of server which hosts the firmware image.

      config SKIP_COMMON_NAME_CHECK
          bool "Skip server certificate CN fieldcheck"
          default n
          help
              This allows you to skip the validation of OTA server certificate CN field.

      config SKIP_VERSION_CHECK
          bool "Skip firmware version check"
          default n
          help
              This allows you to skip the firmware version check.

      config OTA_RECV_TIMEOUT
          int "OTA Receive Timeout"
          default 5000
          help
              Maximum time for reception
  endmenu

endmenu
```

## sdkconfig.defaults
```kconfig
# Default sdkconfig parameters to use the OTA
# partition table layout, with a 4MB flash size
CONFIG_ESPTOOLPY_FLASHSIZE_4MB=y
CONFIG_PARTITION_TABLE_TWO_OTA=y

CONFIG_ESP32_REV_MIN_3=y
CONFIG_ESP32_REV_MIN=3
```
